/*
 * PandaKB Lily58 routes nice!view CS to D0 (P0.08) instead of the
 * standard D1 (P0.06), which is used for the RGB data line on this PCB.
 */
&nice_view_spi {
    cs-gpios = <&pro_micro 0 GPIO_ACTIVE_HIGH>;
};
